/{
encoder_1: encoder_1 {
        compatible = "alps,ec11";
        label = "Encoder 1";
        a-gpios = <&gpio1 02 (GPIO_ACTIVE_LOW | GPIO_PULL_UP)>;
        b-gpios = <&gpio1 07 (GPIO_ACTIVE_LOW | GPIO_PULL_UP)>;
        resolution = <4>;
        status = "disabled";
    };
};